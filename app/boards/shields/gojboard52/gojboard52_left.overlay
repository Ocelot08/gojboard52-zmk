/*
 * Copyright (c) 2020 Pete Johanson
 *
 * SPDX-License-Identifier: MIT
 */

#include "gojboard52.dtsi"

&kscan0 {
    /* Rev 2 PCB: columns shifted one slot so the shared CHANGE/CS signal
     * could move to pro_micro 19 (was COL6). COL1 now sits on pro_micro 9,
     * where the old single-pin CHANGE/CS breakout used to be; COL2-6 each
     * took over the previous column's old pin. Values read from the
     * U1 pad-to-net assignments in BTSplit.kicad_pcb. */
    col-gpios
        = <&pro_micro 9 GPIO_ACTIVE_HIGH>
        , <&pro_micro 10 GPIO_ACTIVE_HIGH>
        , <&pro_micro 16 GPIO_ACTIVE_HIGH>
        , <&pro_micro 14 GPIO_ACTIVE_HIGH>
        , <&pro_micro 15 GPIO_ACTIVE_HIGH>
        , <&pro_micro 18 GPIO_ACTIVE_HIGH>
        ;
};

&pro_micro_i2c {
    status = "okay";

    oled: ssd1306@3c {
        compatible = "solomon,ssd1306fb";
        reg = <0x3c>;
        label = "DISPLAY";
        width = <128>;
        height = <32>;
        segment-offset = <0>;
        page-offset = <0>;
        display-offset = <0>;
        multiplex-ratio = <31>;
        segment-remap;
        com-invdir;
        com-sequential;
        prechargep = <0x22>;
    };
};

/*
&i2c0 {
    status = "okay";
    compatible = "nordic,nrf-twim";
    slider: at42qt2120@1c {
        status = "okay";
        compatible = "microchip,at42qt2120";
        reg = <0x1c>;
        change-gpios = <&gpio1 9 GPIO_ACTIVE_LOW>;
    };
};

&slider {
    status = "okay";
};



&left_encoder {
    status = "okay";
};
*/