/*
 * Same panel definition as the stock nice_view shield (Sharp LS0XX, 160x68).
 * Use this shield INSTEAD of nice_view, together with nice_view_adapter:
 *   -DSHIELD="<your_left_shield> nice_view_adapter nice_view_dual"
 */

&nice_view_spi {
    status = "okay";
    nice_view: ls0xx@0 {
        compatible = "sharp,ls0xx";
        spi-max-frequency = <1000000>;
        reg = <0>;
        width = <160>;
        height = <68>;
        serial-vcom-inversion;
        serial-vcom-interval = <33>;
    };
};

/ {
    chosen {
        zephyr,display = &nice_view;
    };
};
